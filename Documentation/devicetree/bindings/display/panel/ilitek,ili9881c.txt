## Documentation/devicetree/bindings/display/panel/ilitek,ili9881c.txt
```
Ilitek ILI9881c based MIPI-DSI panels

Required properties:
  - compatible: must be "ilitek,ili9881c" and one of:
    * "bananapi,lhr050h41"
  - reg: DSI virtual channel used by that screen
  - power-gpios: a GPIO phandle for the power pin
  - reset-gpios: a GPIO phandle for the reset pin

Optional properties:
  - backlight: phandle to the backlight used

Example:
panel@0 {
	compatible = "bananapi,lhr050h41", "ilitek,ili9881c";
	reg = <0>;
	power-gpios = <&pio 1 7 GPIO_ACTIVE_HIGH>; /* PB07 */
	reset-gpios = <&r_pio 0 5 GPIO_ACTIVE_LOW>; /* PL05 */
	backlight = <&pwm_bl>;
};
```

## Documentation/devicetree/bindings/media/sunxi-cedrus.txt
```
Device-tree bindings for the VPU found in Allwinner SoCs, referred to as the
Video Engine (VE) in Allwinner literature.

The VPU can only access the first 256 MiB of DRAM, that are DMA-mapped starting
from the DRAM base. This requires specific memory allocation and handling.

Required properties:
- compatible	        : "allwinner,sun4i-a10-video-engine";
- memory-region         : DMA pool for buffers allocation;
- clocks	        : list of clock specifiers, corresponding to entries in
                          the clock-names property;
- clock-names	        : should contain "ahb", "mod" and "ram" entries;
- assigned-clocks       : list of clocks assigned to the VE;
- assigned-clocks-rates : list of clock rates for the clocks assigned to the VE;
- resets	        : phandle for reset;
- interrupts	        : should contain VE interrupt number;
- reg		        : should contain register base and length of VE.

Example:

reserved-memory {
	#address-cells = <1>;
	#size-cells = <1>;
	ranges;

	/* Address must be kept in the lower 256 MiBs of DRAM for VE. */
	ve_memory: cma@4a000000 {
		compatible = "shared-dma-pool";
		reg = <0x4a000000 0x6000000>;
		no-map;
		linux,cma-default;
	};
};

video-engine@1c0e000 {
	compatible = "allwinner,sun4i-a10-video-engine";
	reg = <0x01c0e000 0x1000>;
	memory-region = <&ve_memory>;

	clocks = <&ccu CLK_AHB_VE>, <&ccu CLK_VE>,
		 <&ccu CLK_DRAM_VE>;
	clock-names = "ahb", "mod", "ram";

	assigned-clocks = <&ccu CLK_VE>;
	assigned-clock-rates = <320000000>;

	resets = <&ccu RST_VE>;

	interrupts = <GIC_SPI 53 IRQ_TYPE_LEVEL_HIGH>;
};
```

## drivers/media/platform/sunxi/Kconfig
```kconfig
config VIDEO_SUNXI
	bool "Allwinner sunXi family Video Devices"
	depends on ARCH_SUNXI
	help
	  If you have an Allwinner SoC based on the sunXi family, say Y.

	  Note that this option doesn't include new drivers in the
	  kernel: saying N will just cause Kconfig to skip all the
	  questions about Allwinner media devices.

if VIDEO_SUNXI

source "drivers/media/platform/sunxi/cedrus/Kconfig"

endif
```

## drivers/media/platform/sunxi/cedrus/Kconfig
```kconfig
config VIDEO_SUNXI_CEDRUS
	tristate "Allwinner Cedrus VPU driver"
	depends on VIDEO_DEV && VIDEO_V4L2 && MEDIA_CONTROLLER
	depends on HAS_DMA
	select VIDEOBUF2_DMA_CONTIG
	select MEDIA_REQUEST_API
	select V4L2_MEM2MEM_DEV
	help
	  Support for the VPU found in Allwinner SoCs, also known as the Cedar
	  video engine.

	  To compile this driver as a module, choose M here: the module
	  will be called cedrus.
```
